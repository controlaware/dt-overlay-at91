## sama5d3_devboard.its
```
// SPDX-License-Identifier: (GPL-2.0+ OR MIT)
/*
 * devboard_sama5d3.its - Flattened Image Tree file for ControlAware SAMA5D3 Dev Board
 *
 * Copyright (C) 2020 ControlAware LLC.
 * Author: Ron Beyer <rbeyer@controlaware.com>
 *
 */
/dts-v1/;

/ {
	description = "ControlAware SAMA5D3 Dev Board FIT Image";
	#address-cells = <1>;

	images {
		kernel@1 {
			description = "Linux4SAM Linux kernel";
			data = /incbin/("./zImage");
			type = "kernel";
			arch = "arm";
			os = "linux";
			compression = "none";
			load = <0x22000000>;
			entry = <0x22000000>;
			hash@1 {
				algo = "crc32";
			};
			hash@2 {
				algo = "sha1";
			};
		};

		base_fdt {
			description = "Flattened Device Tree blob";
			data = /incbin/("./at91-sama5d3-devboard.dtb");
			type = "flat_dt";
			arch = "arm";
			compression = "none";
			load = <0x23000000>;
			hash@1 {
				algo = "crc32";
			};
			hash@2 {
				algo = "sha1";
			};
		};

	};

	configurations {
		default = "kernel_dtb";

		kernel_dtb {
			description = "Linux kernel and base FDT blob for SAMA5D3_XPLAINED board";
			kernel = "kernel@1";
			fdt = "base_fdt";
		};

		base_dtb {
			description = "FDT blob for base SAMA5D3_XPLAINED board";
			fdt = "base_fdt";
		};

	};
};
```
